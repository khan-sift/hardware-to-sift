VERSION ""

NS_ :

BS_:

BU_: ECU

BO_ 256 MOTOR_STATUS: 8 ECU
 SG_ speed_kph : 0|16@1+ (0.1,0) [0|6553.5] "kph" ECU
 SG_ motor_temp : 16|8@1+ (1,-40) [-40|215] "degC" ECU

BO_ 257 BATT_STATUS: 8 ECU
 SG_ BATT_Voltage : 0|16@1+ (0.01,0) [0|655.35] "V" ECU
 SG_ BATT_Current : 16|16@1- (0.1,0) [-3276.8|3276.7] "A" ECU
